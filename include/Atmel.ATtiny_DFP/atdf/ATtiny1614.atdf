# ATtiny1614 device description
Architecture: AVR8X; Family: AVR TINY
Programming and debug interfaces: UPDI
Registers are 8-bit, read-write, reset 0x0 unless marked. A register's access mark holds for its fields unless they carry their own. Offsets are from the block's base; lines under a group give offsets from that group; [hi:lo] are bit positions; {n}, {i} and the like mark numbered series; 'fields as' and 'values as' point back to an identical list; <NAME> marks a mode.

## Ordering variants
ATtiny1614-SSFR: SOIC14, up to 20 MHz, -40 to 125 C, 1.8 to 5.5 V
ATtiny1614-SSNR: SOIC14, up to 20 MHz, -40 to 105 C, 1.8 to 5.5 V

## Memory
data space: start 0x0000 size 0xC000, little endian
  0x00001400 EEPROM size 0x0100 eeprom, rw, page 0x20
  0x00001280 FUSES size 0xA fuses, rw, page 0x20
  0x3800 INTERNAL_SRAM size 0x0800 ram, rw
  0x00000000 IO size 0x1100 io, rw
  0x0000128A LOCKBITS size 0x1 lockbits, rw, page 0x20
  0x00008000 MAPPED_PROGMEM size 0x4000 other, rw, page 0x40
  0x00001103 PROD_SIGNATURES size 0x3D signatures, ro, page 0x40
  0x00001100 SIGNATURES size 0x3 signatures, ro, page 0x40
  0x00001300 USER_SIGNATURES size 0x20 user_signatures, rw, page 0x20
prog space: start 0x0000 size 0x4000, little endian
  0x00000000 PROGMEM size 0x4000 flash, rw, executable, page 0x40

## Peripheral instances (address, pins/pin function, parameters)
AC0 at 0x0680 (AC)
  pins: N0 PA6; OUT0 PA5; P0 PA7; P2 PB1
AC1 at 0x0688 (AC)
  pins: N0 PA5; OUT0 PB3; P0 PA7; P1 PA6; P2 PB0
AC2 at 0x0690 (AC)
  pins: N0 PA7; OUT0 PB2; P0 PA6; P1 PB0
ADC0 at 0x0600 (ADC)
  pins: AIN{n} PA{n}/AIN0 (n=0..7); AIN10 PB1/AIN0; AIN11 PB0/AIN0
ADC1 at 0x0640 (ADC)
  pins: AIN0 PA4/AIN1; AIN1 PA5/AIN1; AIN2 PA6/AIN1; AIN3 PA7/AIN1
BOD at 0x0080
CCL at 0x01C0
  pins: LUT0_IN0 PA0; LUT0_IN1 PA1; LUT0_IN2 PA2; LUT0_OUT0 PA4; LUT1_OUT0 PA7
  pin routing set by: PORTMUX.CTRLA.LUT0, PORTMUX.CTRLA.LUT1
CLKCTRL at 0x0060
  pins: CLKI PA3; TOSC1 PB3; TOSC2 PB2
CPU at 0x0030
  pins: BREAK PA1/BREAK
  pin routing set by: PORTMUX.CTRLA.EXTBRK
  parameters: CORE_VERSION=V4
CPUINT at 0x0110
CRCSCAN at 0x0120
DAC0 at 0x06A0 (DAC)
  pins: OUT0 PA6
DAC1 at 0x06A8 (DAC)
DAC2 at 0x06B0 (DAC)
EVSYS at 0x0180
  pins: EVAPA{n} PA{n}/EVAINCH0 (n=0..7); EVAPB0 PB0/EVAINCH1; EVAPB1 PB1/EVAINCH1; EVAPB2 PB2/EVAINCH1; EVAPB3 PB3/EVAINCH1; EVOUT0 PA2; EVOUT1 PB2; EVSPA{n} PA{n}/EVSINCH0 (n=0..7); EVSPB0 PB0/EVSINCH1; EVSPB1 PB1/EVSINCH1; EVSPB2 PB2/EVSINCH1; EVSPB3 PB3/EVSINCH1
  pin routing set by: EVSYS.ASYNCCH0.ASYNCCH0, EVSYS.ASYNCCH1.ASYNCCH1, PORTMUX.CTRLA.EVOUT0, PORTMUX.CTRLA.EVOUT1, EVSYS.SYNCCH0.SYNCCH0, EVSYS.SYNCCH1.SYNCCH1
FUSE at 0x1280
GPIO at 0x001C
LOCKBIT at 0x128A
NVMCTRL at 0x1000
PORTA at 0x0400 (PORT)
  pins: PIN{n} PA{n}/IOPORT (n=0..7)
PORTB at 0x0420 (PORT)
  pins: PIN0 PB0/IOPORT; PIN1 PB1/IOPORT; PIN2 PB2/IOPORT; PIN3 PB3/IOPORT
PORTMUX at 0x0200
PTC
  pins: DS0 PB2/PTC_DS; X0 PA4/PTC_X; X1 PA5/PTC_X; X2 PA6/PTC_X; X3 PA7/PTC_X; X4 PB1/PTC_X; X5 PB0/PTC_X; Y0 PA4/PTC_Y; Y1 PA5/PTC_Y; Y2 PA6/PTC_Y; Y3 PA7/PTC_Y; Y4 PB1/PTC_Y; Y5 PB0/PTC_Y
RSTCTRL at 0x0040
  pins: RESET PA0/OTHER
RTC at 0x0140
SIGROW at 0x1100
SLPCTRL at 0x0050
SPI0 at 0x0820 (SPI)
  pins: MISO PA2; MOSI PA1; SCK PA3; SS PA4
  pin routing set by: PORTMUX.CTRLB.SPI0
SYSCFG at 0x0F00
  pins: UPDI PA0/OTHER
TCA0 at 0x0A00 (TCA)
  pins: WO0 PB3/TCA0_ALT or PB0; WO1 PB1; WO2 PB2; WO3 PA3; WO4 PA4; WO5 PA5
  pin routing set by: PORTMUX.CTRLC.TCA00, PORTMUX.CTRLC.TCA01, PORTMUX.CTRLC.TCA02, PORTMUX.CTRLC.TCA03, PORTMUX.CTRLC.TCA04, PORTMUX.CTRLC.TCA05
TCB0 at 0x0A40 (TCB)
  pins: WO0 PA5
  pin routing set by: PORTMUX.CTRLD.TCB0
TCB1 at 0x0A50 (TCB)
  pins: WO0 PA3
  pin routing set by: PORTMUX.CTRLD.TCB1
TCD0 at 0x0A80 (TCD)
  pins: WOA PA4; WOB PA5
TWI0 at 0x0810 (TWI)
  pins: SCL PA2/TWI0_ALT or PB0; SDA PA1/TWI0_ALT or PB1
  pin routing set by: PORTMUX.CTRLB.TWI0
USART0 at 0x0800 (USART)
  pins: RXD PA2/USART0_ALT or PB3; TXD PA1/USART0_ALT or PB2; XCK PA3/USART0_ALT or PB1; XDIR PA4/USART0_ALT or PB0
  pin routing set by: PORTMUX.CTRLB.USART0
USERROW at 0x1300
VPORTA at 0x0000 (VPORT)
VPORTB at 0x0004 (VPORT)
VPORTC at 0x0008 (VPORT)
VREF at 0x00A0
WDT at 0x0100

## Interrupts
1 NMI (CRCSCAN)
2 VLM (BOD)
3 PORT (PORTA)
4 PORT (PORTB)
6 CNT (RTC)
7 PIT (RTC)
8 LUNF (TCA0)
8 OVF (TCA0)
9 HUNF (TCA0)
10 CMP0 (TCA0)
10 LCMP0 (TCA0)
11 CMP1 (TCA0)
11 LCMP1 (TCA0)
12 CMP2 (TCA0)
12 LCMP2 (TCA0)
13 INT (TCB0)
14 INT (TCB1)
15 OVF (TCD0)
16 TRIG (TCD0)
17 AC (AC0)
18 AC (AC1)
19 AC (AC2)
20 RESRDY (ADC0)
21 WCOMP (ADC0)
22 RESRDY (ADC1)
23 WCOMP (ADC1)
24 TWIS (TWI0)
25 TWIM (TWI0)
26 INT (SPI0)
27 RXC (USART0)
28 DRE (USART0)
29 TXC (USART0)
30 EE (NVMCTRL)

## Properties
OCD_FEATURES: BREAK_PIN=PA1, BREAK_PIN_ALT=PC4
SIGNATURES: SIGNATURE0=0x1E, SIGNATURE1=0x94, SIGNATURE2=0x22

## Pinouts (pin number, pad)
SOIC14: 1 VDD, 2 PA4, 3 PA5, 4 PA6, 5 PA7, 6 PB3, 7 PB2, 8 PB1, 9 PB0, 10 PA0, 11 PA1, 12 PA2, 13 PA3, 14 GND
